## config/west.yml
```yaml
manifest:
    defaults:
        revision: main
    remotes:
        - name: caksoylar
          url-base: https://github.com/caksoylar
        - name: nickconway
          url-base: https://github.com/nickconway
        - name: beekeeb
          url-base: https://github.com/beekeeb
    projects:
        - name: zmk-rgbled-widget
          remote: caksoylar
          path: extra-modules/zmk-rgbled-widget
        - name: zmk-component-sharp-display
          remote: nickconway
          path: extra-modules/sharp-display
        - name: zmk-component-azoteq-tps43
          remote: nickconway
          revision: multi-finger
          path: extra-modules/azoteq
    self:
        path: config
```
